## arch/arm/mach-tegra/Kconfig
```kconfig
if TEGRA

choice
	prompt "Tegra SoC select"
	optional

config TEGRA20
	bool "Tegra20 family"
	select SUPPORT_SPL
	select SPL
	select OF_CONTROL
	select CPU_V7
	select DM
	select DM_SPI_FLASH
	select DM_SERIAL
	select DM_I2C
	select DM_SPI
	select DM_GPIO

config TEGRA30
	bool "Tegra30 family"
	select SUPPORT_SPL
	select SPL
	select OF_CONTROL
	select CPU_V7
	select DM
	select DM_SPI_FLASH
	select DM_SERIAL
	select DM_I2C
	select DM_SPI
	select DM_GPIO

config TEGRA114
	bool "Tegra114 family"
	select SUPPORT_SPL
	select SPL
	select OF_CONTROL
	select CPU_V7
	select DM
	select DM_SPI_FLASH
	select DM_SERIAL
	select DM_I2C
	select DM_SPI
	select DM_GPIO

config TEGRA124
	bool "Tegra124 family"
	select SUPPORT_SPL
	select SPL
	select OF_CONTROL
	select CPU_V7
	select DM
	select DM_SPI_FLASH
	select DM_SERIAL
	select DM_I2C
	select DM_SPI
	select DM_GPIO

config TEGRA132
	bool "Tegra132 family"
	select ARM64
	select OF_CONTROL

endchoice

config SYS_MALLOC_F_LEN
	default 0x1800

config USE_PRIVATE_LIBGCC
	depends on SPL
	default y

config SPL_DM
	default y

source "arch/arm/mach-tegra/tegra20/Kconfig"
source "arch/arm/mach-tegra/tegra30/Kconfig"
source "arch/arm/mach-tegra/tegra114/Kconfig"
source "arch/arm/mach-tegra/tegra124/Kconfig"
source "arch/arm/mach-tegra/tegra132/Kconfig"

endif
```

## arch/arm/mach-tegra/tegra132/Kconfig
```kconfig
if TEGRA132

choice
	prompt "Tegra132 board select"

config TARGET_NORRIN
	bool "NVIDIA Tegra132 Norrin board"

endchoice

config SYS_SOC
	default "tegra132"

source "board/nvidia/norrin/Kconfig"

endif
```

## arch/arm/mach-tegra/tegra210/Kconfig
```kconfig
if TEGRA210

choice
	prompt "Tegra210 board select"

config TARGET_P2371_E01
	bool "NVIDIA Tegra210 P2371 reference board (E.1)"

config TARGET_P2571_E01
	bool "NVIDIA Tegra210 P2571 reference board (E.1)"

endchoice

config SYS_SOC
	default "tegra210"

source "board/nvidia/p2371-e01/Kconfig"
source "board/nvidia/p2571-e01/Kconfig"

endif
```

## board/nvidia/foster/Kconfig
```kconfig
if TARGET_FOSTER

config SYS_BOARD
	default "foster"

config SYS_VENDOR
	default "nvidia"

config SYS_CONFIG_NAME
	default "foster"

endif
```

## board/nvidia/jetson-erista/Kconfig
```kconfig
if TARGET_JETSON_ERISTA

config SYS_BOARD
	default "jetson-erista"

config SYS_VENDOR
	default "nvidia"

config SYS_CONFIG_NAME
	default "jetson-erista"

endif
```

## board/nvidia/norrin/Kconfig
```kconfig
if TARGET_NORRIN

config SYS_BOARD
	default "norrin"

config SYS_VENDOR
	default "nvidia"

config SYS_CONFIG_NAME
	default "norrin"

endif
```

## board/nvidia/p2371-e01/Kconfig
```kconfig
if TARGET_P2371_E01

config SYS_BOARD
	default "p2371-e01"

config SYS_VENDOR
	default "nvidia"

config SYS_CONFIG_NAME
	default "p2371-e01"

endif
```

## board/nvidia/p2571-e01/Kconfig
```kconfig
if TARGET_P2571_E01

config SYS_BOARD
	default "p2571-e01"

config SYS_VENDOR
	default "nvidia"

config SYS_CONFIG_NAME
	default "p2571-e01"

endif
```

## configs/foster_defconfig
```kconfig
CONFIG_ARM=y
CONFIG_TEGRA=y
CONFIG_TEGRA210=y
CONFIG_TARGET_FOSTER=y
CONFIG_DEFAULT_DEVICE_TREE="tegra210-foster"
```

## configs/jetson-erista_defconfig
```kconfig
CONFIG_ARM=y
CONFIG_TEGRA=y
CONFIG_TEGRA210=y
CONFIG_TARGET_JETSON_ERISTA=y
CONFIG_DEFAULT_DEVICE_TREE="tegra210-jetson-erista"
```

## configs/norrin_defconfig
```kconfig
CONFIG_ARM=y
CONFIG_TEGRA=y
CONFIG_TEGRA132=y
CONFIG_TARGET_NORRIN=y
CONFIG_DEFAULT_DEVICE_TREE="tegra132-norrin"
```

## configs/p2371-e01_defconfig
```kconfig
CONFIG_ARM=y
CONFIG_TEGRA=y
CONFIG_TEGRA210=y
CONFIG_TARGET_P2371_E01=y
CONFIG_DEFAULT_DEVICE_TREE="tegra210-p2371-e01"
```

## configs/p2571-e01_defconfig
```kconfig
CONFIG_ARM=y
CONFIG_TEGRA=y
CONFIG_TEGRA210=y
CONFIG_TARGET_P2571_E01=y
CONFIG_DEFAULT_DEVICE_TREE="tegra210-p2571-e01"
```
